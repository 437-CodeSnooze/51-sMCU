#include <REGX52.H>
#include "Delay.h"
#include "Matrix LED.h"
unsigned char i;
unsigned char a=0;


sbit RCK=P3^5;     //RCLK
sbit SCK=P3^6;     //SRCLK
sbit SER=P3^4;     //SER

unsigned char Animation[56]=
{0x04,0x02,0x02,0xFC,0x00,0x3C,0x02,0x02,0x3C,0x02,0x00,0x12,0x2A,0x2A,0x24,0x00,
0x00,0x10,0x7E,0x12,0x04,0x00,0x00,0x06,0x09,0x09,0x7E,0x00,0x06,0x09,0x09,0x06,
0x00,0x00,0x00,0x2E,0x00,0x00,0x10,0x7E,0x12,0x04,0x00,0x00,0x00,0x3D,0x00,0x00,0x00,0x00,0x00,0x00,0x00,0x00,0x00,0x00
};


void main()
{
  MatrixLED_Init();
	while(1)
	{
      for(i=0;i<56;i++)
		{
			MartrixLED_ShowColumn(0,Animation[i]);
			MartrixLED_ShowColumn(1,Animation[i+1]);
			MartrixLED_ShowColumn(2,Animation[i+2]);
			MartrixLED_ShowColumn(3,Animation[i+3]);
			MartrixLED_ShowColumn(4,Animation[i+4]);
			MartrixLED_ShowColumn(5,Animation[i+5]);
			MartrixLED_ShowColumn(6,Animation[i+6]);
			MartrixLED_ShowColumn(7,Animation[i+7]);
			Delay(20);
			if((i+8)==56)
			{
				i=0;
			}
		}
	}
}
